#include "ReversedCharset.h"

void ReversedCharset::displayString(int row, int offset, const char* text, bool clearBackground) {
  row = LCDDisplay::ROW_COUNT - 1 - row;
  offset = LCDDisplay::DISPLAY_WIDTH - 1 - offset;
  
  while (*text) {
    if (*text == ' ') {
      if (clearBackground) {
        display->fillRow(row, offset - 3, 3, 0);
        offset -= 3;
      }
    } else {
      int8_t address = pgm_read_byte(CHAR_LOOKUP_TABLE + *text);
      if (address >= 0) {
        uint8_t buffer[16];
        
        uint16_t lowOffset = pgm_read_word(CHARACTER_OFFSETS + address);
        uint16_t highOffset = pgm_read_word(CHARACTER_OFFSETS + address + 1);
        
        for (int i = 0; i < highOffset - lowOffset; i++) {
          buffer[i] = pgm_read_byte(CHARSET_DATA + lowOffset + i);
        }
        buffer[highOffset - lowOffset] = 0;
        const int dataLen = highOffset - lowOffset + 1;
        
        display->writeRow(row, offset - dataLen, dataLen, buffer);
        offset -= dataLen;
      } else {
        Serial.print("Trying to print character that is not represented in the charset. Char code: ");
        Serial.println(static_cast<int>(*text));
      }
    }
    text++;
  }
}

ReversedCharset :: ReversedCharset(LCDDisplay* display) : display(display) {
}

const uint8_t ReversedCharset::CHARSET_DATA[] PROGMEM = { 0x28, 0x70, 0xa8, 0x50, 0x50, 0x50, 0x50, 0x50, 0x20, 0x50, 0x88, 0x88, 0x50,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 0x50, 0x38 };
const uint16_t ReversedCharset::CHARACTER_OFFSETS[] PROGMEM = { 0, 4, 8, 11, 14, 17, 18, 19, 24, 26, 28, 30, 32,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 272, 277 };
const int8_t ReversedCharset::CHAR_LOOKUP_TABLE[] PROGMEM = { -1, -1, -1, -1, -1, -1, -1, -1, -1, -1, -1, -1, -1,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 -1, -1 };


